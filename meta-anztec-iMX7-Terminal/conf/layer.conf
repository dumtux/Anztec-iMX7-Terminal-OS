## meta-anztec-iMX7-Terminal/conf/layer.conf
```bitbake
# We have a conf and classes directory, add to BBPATH
BBPATH .= ":${LAYERDIR}"

# We have recipes-* directories, add to BBFILES
BBFILES += "${LAYERDIR}/recipes-*/*/*.bb \
            ${LAYERDIR}/recipes-*/*/*.bbappend"

BBFILE_COLLECTIONS += "meta-anztec-iMX7-Terminal"
BBFILE_PATTERN_meta-anztec-iMX7-Terminal = "^${LAYERDIR}/"
BBFILE_PRIORITY_meta-anztec-iMX7-Terminal = "6"

LAYERDEPENDS_meta-anztec-iMX7-Terminal = "core"
LAYERSERIES_COMPAT_meta-anztec-iMX7-Terminal = "kirkstone"
```
